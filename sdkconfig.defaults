## sdkconfig.defaults
```kconfig
CONFIG_AUTOSTART_ARDUINO=y
CONFIG_FREERTOS_HZ=1000

# Use TinyUSB for USB OTG CDC
CONFIG_TINYUSB=y
CONFIG_TINYUSB_ENABLED=y
CONFIG_TINYUSB_CDC_ENABLED=y
CONFIG_TINYUSB_CDC_COUNT=1

# esp32-s3 uses this but idk about p4 because I can't find it in our directory nor the usb_device_uvc library on github 
# CONFIG_TINYUSB_VIDEO_ENABLED=y

# Arduino USB mode (0 = external PHY/OTG, 1 = internal USB-JTAG)
CONFIG_ARDUINO_USB_MODE=0
CONFIG_ARDUINO_USB_CDC_ON_BOOT=1

# Disable USB Serial/JTAG since we're using USB OTG
# CONFIG_ESP_CONSOLE_USB_SERIAL_JTAG is not set

# Enable PSRAM for camera frame buffers
CONFIG_SPIRAM=y
CONFIG_SPIRAM_MODE_OCT=y
CONFIG_SPIRAM_SPEED_200M=y

# UVC Configuration
CONFIG_UVC_SUPPORT_TWO_CAM=n
CONFIG_UVC_MODE_BULK_CAM1=y
CONFIG_FORMAT_H264_CAM1=y  
CONFIG_UVC_CAM1_FRAMERATE=24
CONFIG_UVC_CAM1_FRAMESIZE_WIDTH=720
CONFIG_UVC_CAM1_FRAMESIZE_HEIGT=480
```
